## components/framework/app_registry/Kconfig
```kconfig
menu "App Registry"

    config APP_REGISTRY_MAX_ENTRIES
        int "Max registered apps"
        default 8
        range 1 32
        help
            登録できる app の最大数です。
            entry はポインタで保持するため、消費 RAM は この値 x 4 バイトです。
            English: entries are borrowed pointers, so RAM cost is value x 4 bytes.

endmenu
```

## components/framework/app_shell/Kconfig
```kconfig
menu "App Shell"

    config APP_SHELL_TASK_STACK_SIZE
        int "App shell task stack size"
        default 10240
        range 6144 16384
        help
            `app_shell` task の stack size です。
            English: this single owner task runs the active foreground app and
            owns `cyd_display`, so its stack must cover the active app step.

    config APP_SHELL_TASK_PRIORITY
        int "App shell task priority"
        default 5
        range 1 24
        help
            `app_shell` task priority です。

    config APP_SHELL_IDLE_RETURN_TIMEOUT_SECONDS
        int "Idle return timeout (seconds)"
        default 60
        range 0 3600
        help
            無操作で home app へ自動復帰するまでの秒数です。
            0 を指定すると自動復帰を無効化します。
            English: inactivity timeout before the shell returns to the home app.

    config APP_SHELL_MAX_CONSECUTIVE_ERRORS
        int "Max consecutive app errors before returning home"
        default 10
        range 1 255
        help
            app の enter / step が連続で失敗した回数がこの値に達すると、
            shell はその app を諦めて home app へ復帰します。
            app 側が `on_error` を実装している場合は、そちらの判断が優先されます。
            English: default error budget. An app failure is a normal runtime
            condition (I2C NACK, UART overflow, sensor timeout) and never panics
            the device; this only decides when the shell gives up on the app.

    config APP_SHELL_ERROR_BACKOFF_MS
        int "Backoff after an app error (ms)"
        default 100
        range 0 5000
        help
            app のエラー1回ごとに shell が待つ時間です。
            English: mandatory throttle. Without it, a step() that fails
            immediately would spin the shell task and starve lower priority
            tasks. Only set this to 0 if every app is known to block internally.

endmenu
```

## components/products/cyd_clock_composition/Kconfig
```kconfig
menu "CYD Clock Composition"

    config CYD_CLOCK_COMPOSITION_HOME_LAUNCHER
        bool "Boot into the app launcher instead of the clock"
        default n
        help
            有効にすると、home app が clock ではなく汎用の app launcher になります。
            launcher は app_registry に登録された app を一覧するだけなので、
            製品固有の知識を持ちません。
            無操作時の自動復帰先も home app なので、この設定で一緒に変わります。
            English: the home app is a product choice. Idle auto-return targets
            the home app, so this switch changes that destination too.

endmenu
```

## components/services/error_log_store/Kconfig
```kconfig
menu "Error Log Store"

    config ERROR_LOG_STORE_HOLD_BYTES
        int "RAM for lines that cannot be written yet (bytes)"
        default 4096
        range 512 16384
        help
            カードがまだ使えない間、または時刻の判定が済むまでの間、エラーの行を
            RAM に溜めておく大きさです。あふれたときは新しい行を捨てて、捨てた件数を
            ログの最初の行に書きます。1 行は 100 バイト前後なので、4096 で約 35 行です。
            English: room for lines waiting for the card or for the clock question to be
            answered. When full, the newest are refused and counted.

    config ERROR_LOG_STORE_TIME_WAIT_SECONDS
        int "Longest wait for the clock question (seconds)"
        default 180
        range 10 3600
        help
            時刻同期の成功も失敗も報告されないまま (Wi-Fi 設定中、時刻同期なしのビルドなど)
            起動からこの秒数が過ぎたら、失敗として扱って書き始めます。このとき時計が
            合っていなければ、ファイル名は 1970-01-01 の日付になります。
            通常の失敗 (接続できない: 最大約 30 秒、NTP が 6 回失敗: 最大約 2〜3 分) より
            長くしてください。
            English: after this long since boot without an answer, writing starts as if the
            sync had failed.

    config ERROR_LOG_STORE_REPEAT_WINDOW_SECONDS
        int "Window for folding repeated errors (seconds)"
        default 10
        range 0 600
        help
            同じ行 (タグ・関数・行・コード・メッセージが同じ) がこの秒数の間に繰り返したら、
            最初の 1 行だけ書き、窓の最後に「N 回繰り返した」と 1 行書きます。0 で無効です。
            English: the same line repeating inside this window is written once, then
            counted. 0 turns folding off.

endmenu
```

## components/services/sd_card_status/Kconfig
```kconfig
menu "SD Card Status"

    config SD_CARD_STATUS_POLL_INTERVAL_MS
        int "Card check interval while mounted (ms)"
        default 5000
        range 1000 60000
        depends on SD_CARD_STORAGE_ENABLED
        help
            マウント中に、カードが応答するか・空き容量が足りるかを確認する間隔です。
            English: how often a mounted card is probed for presence and free space.

    config SD_CARD_STATUS_RETRY_INITIAL_MS
        int "First retry delay after a failure (ms)"
        default 5000
        range 1000 600000
        depends on SD_CARD_STORAGE_ENABLED
        help
            カード未挿入・未フォーマットなどで失敗した後、再マウントを試す最初の待ち時間です。
            失敗が続くと倍々に伸びます。
            English: first wait before trying to mount again; it doubles while failures continue.

    config SD_CARD_STATUS_RETRY_SEEN_MS
        int "Retry delay once a card has worked (ms)"
        default 3000
        range 500 60000
        depends on SD_CARD_STORAGE_ENABLED
        help
            起動後に一度でもカードが正常に動いた個体は、未挿入・未フォーマットの間、
            この固定間隔で再マウントを試します。カードを抜いて PC で読み、戻す、という
            使い方で、戻してから気づくまでの待ちを短くするためです。一度もカードを
            見ていない個体は、RETRY_INITIAL_MS から RETRY_MAX_MS まで間隔を伸ばします。
            書き込み失敗 (FAULT) の再試行は、この設定の対象外で、間隔を伸ばします。

            English: once a card has worked since boot, a missing or unformatted card
            is retried at this fixed interval, so a card pulled to be read on a PC is
            picked up quickly when it is put back. Units that never saw a card, and
            retries after a write failure, keep the growing delay.

    config SD_CARD_STATUS_RETRY_MAX_MS
        int "Longest retry delay (ms)"
        default 60000
        range 1000 3600000
        depends on SD_CARD_STORAGE_ENABLED
        help
            再マウントの待ち時間の上限です。カードを使わない個体が、シリアルログを
            埋めないようにするためのものです。
            English: cap on the retry delay, so a unit that runs without a card does
            not keep the SPI bus and the serial log busy.

    config SD_CARD_STATUS_MIN_FREE_KB
        int "Treat the card as full below this much free space (KB)"
        default 1024
        range 0 1048576
        depends on SD_CARD_STORAGE_ENABLED
        help
            空きがこれを下回ると FULL とし、エラーログへの書き込みを止めます。
            0 にすると、完全に空きが無いときだけ FULL にします。
            English: below this the state is FULL and the error log stops writing,
            instead of running into a write error. 0 means only a completely full card.

    config SD_CARD_STATUS_SHOW_ICON
        bool "Offer an icon for SD card problems"
        default y
        depends on SD_CARD_STORAGE_ENABLED
        help
            SD カードの未挿入・未フォーマット・空き容量なし・異常のとき、
            sd_card_status_icon_for_state() がアイコンを返します。画面に出すかどうかは
            各 app が決めますが、これを無効にすると、どの app にもアイコンが出なくなります。
            ログ自体は、このスイッチと関係なく動きます。

            カードを使わない個体では、未挿入のアイコンが出続けるので無効にしてください。

            English: with this off, sd_card_status_icon_for_state() returns NULL for every
            state, so no app draws an icon. Logging is not affected. Turn it off for units
            that run without a card on purpose; they would show the NO_CARD icon for good.

    config SD_CARD_STATUS_TASK_STACK_SIZE
        int "SD card status task stack size"
        default 6144
        range 3072 16384
        depends on SD_CARD_STORAGE_ENABLED
        help
            マウント処理 (カード情報の printf を含む) とセルフテストの書き込みが
            このタスクで走ります。
            English: the card mount, its info printout and the write self-test run here.

    config SD_CARD_STATUS_TASK_PRIORITY
        int "SD card status task priority"
        default 3
        range 1 10
        depends on SD_CARD_STORAGE_ENABLED

endmenu
```

## components/services/sd_card_writer/Kconfig
```kconfig
menu "SD Card Writer"

    config SD_CARD_WRITER_TASK_STACK_SIZE
        int "Writer task stack size"
        default 4096
        range 3072 16384

    config SD_CARD_WRITER_TASK_PRIORITY
        int "Writer task priority"
        default 5
        range 1 24
        help
            SD カードへの書き込みはすべてこの task が行います。書き込み中の
            待ちでほかの処理を止めないよう、UI や Wi-Fi の task より低くしています。
            English: every write to the card runs on this task. Keep it below
            the UI and Wi-Fi tasks so card latency never holds them up.

    config SD_CARD_WRITER_MAX_STREAMS
        int "Maximum open streams"
        default 4
        range 1 16
        help
            同時に開いておける stream の数です。stream ごとに file を1つ開いた
            ままにするので、SD_CARD_STORAGE_MOUNT_MAX_FILES より少なくしてください。
            English: each stream keeps one file open. Keep this below
            SD_CARD_STORAGE_MOUNT_MAX_FILES so ad-hoc file access still has a slot.

    config SD_CARD_WRITER_CHUNK_SIZE
        int "Write chunk size (bytes)"
        default 8192
        range 512 32768
        help
            1回の write() で渡す最大量です。512 の倍数にしてください。大きいほど
            1回の転送でまとめて書けますが、同じ大きさの DMA 用 RAM を使います。
            English: largest single write handed to FATFS, in whole 512-byte
            sectors. Also the size of the writer's DMA-capable staging buffer.

    config SD_CARD_WRITER_TICK_MS
        int "Writer wake interval (ms)"
        default 100
        range 10 1000
        help
            producer からの通知がなくても、この間隔で起きて sync の期限を確認します。
            English: the writer also wakes this often to run interval syncs of
            streams that went quiet.

    config SD_CARD_WRITER_BENCHMARK
        bool "Run a write throughput benchmark at start"
        default n
        help
            writer の起動直後に BENCH.BIN へ一定レートで書き込み、実際に SD へ
            書けた量と取りこぼしをログに出します。確認用で、通常は無効です。
            English: at writer start, writes BENCH.BIN at a fixed rate and logs
            what reached the card and what was dropped. For measurement only.

    config SD_CARD_WRITER_BENCHMARK_RATE_KBPS
        int "Benchmark rate (KB/s)"
        default 100
        range 1 4096
        depends on SD_CARD_WRITER_BENCHMARK

    config SD_CARD_WRITER_BENCHMARK_SECONDS
        int "Benchmark duration (s)"
        default 30
        range 1 3600
        depends on SD_CARD_WRITER_BENCHMARK

    config SD_CARD_WRITER_BENCHMARK_BUFFER_KB
        int "Benchmark stream buffer (KB)"
        default 32
        range 4 128
        depends on SD_CARD_WRITER_BENCHMARK

    config SD_CARD_WRITER_BENCHMARK_BLOCK_BYTES
        int "Benchmark record size (bytes)"
        default 1024
        range 16 16384
        depends on SD_CARD_WRITER_BENCHMARK

endmenu
```

## components/services/wifi_rssi_history/Kconfig
```kconfig
menu "Wi-Fi RSSI History"

    config WIFI_RSSI_HISTORY_TASK_STACK_SIZE
        int "RSSI sampler task stack size"
        default 3072
        range 2048 8192
        help
            接続中の AP の RSSI をサンプリングする task の stack size です。
            この task は radio を起動せず、radio lease も取得しません。
            English: stack of the sampler task. It only reads what an already
            associated STA reports and never acquires a radio lease.

    config WIFI_RSSI_HISTORY_TASK_PRIORITY
        int "RSSI sampler task priority"
        default 4
        range 1 24

    config WIFI_RSSI_HISTORY_SAMPLE_INTERVAL_MS
        int "RSSI sampling interval (ms)"
        default 1000
        range 200 60000
        help
            接続中の AP の RSSI を取得する間隔です。
            未接続になったときは切断を表す gap marker を 1 つだけ記録し、
            その後は記録しません。
            English: while not associated, a single gap marker records the
            break, so gaps never appear as fake readings.

    config WIFI_RSSI_HISTORY_MAX_SAMPLES
        int "RSSI history length (samples)"
        default 120
        range 16 320
        help
            保持するサンプル数です。int16_t で保持するため、
            消費 RAM は この値 x 2 バイトになります。
            グラフの横幅はディスプレイ上 320 px なので、
            320 を超える値を指定しても表示の情報量は増えません。
            English: RAM cost is value x 2 bytes. Values above the 320 px
            display width add no visible detail.

endmenu
```
