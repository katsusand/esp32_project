## components/platform/cyd_display/Kconfig
```kconfig
menu "CYD Display"

    choice CYD_DISPLAY_PANEL_TYPE
        prompt "CYD TFT panel type"
        default CYD_DISPLAY_PANEL_ILI9341
        help
            Some CYD-compatible clone boards ship with alternate LCD controller
            variants or init sequences despite looking identical externally.

        config CYD_DISPLAY_PANEL_ILI9341
            bool "ILI9341"

        config CYD_DISPLAY_PANEL_ILI9341_2
            bool "ILI9341 variant 2"

        config CYD_DISPLAY_PANEL_ST7789
            bool "ST7789"
    endchoice

    config CYD_DISPLAY_WIDTH
        int "CYD display logical width"
        default 320
        range 1 2048

    config CYD_DISPLAY_HEIGHT
        int "CYD display logical height"
        default 240
        range 1 2048

    config CYD_DISPLAY_ROTATION
        int "CYD default rotation"
        default 1
        range 0 7
        help
            Standard ESP32-2432S028R boards are typically used in landscape
            orientation with rotation set to 1.

    config CYD_DISPLAY_BACKLIGHT_GPIO
        int "CYD backlight GPIO"
        default 21
        range -1 48

    config CYD_DISPLAY_BACKLIGHT_BRIGHTNESS
        int "CYD backlight brightness"
        default 192
        range 0 255

    config CYD_DISPLAY_SPI_HOST
        int "CYD TFT SPI host"
        default 2
        range 2 3
        help
            2 = SPI2_HOST, 3 = SPI3_HOST.

    config CYD_DISPLAY_PIN_SCLK
        int "CYD TFT SCLK GPIO"
        default 14
        range -1 48

    config CYD_DISPLAY_PIN_MOSI
        int "CYD TFT MOSI GPIO"
        default 13
        range -1 48

    config CYD_DISPLAY_PIN_MISO
        int "CYD TFT MISO GPIO"
        default 12
        range -1 48

    config CYD_DISPLAY_PIN_DC
        int "CYD TFT DC GPIO"
        default 2
        range -1 48

    config CYD_DISPLAY_PIN_CS
        int "CYD TFT CS GPIO"
        default 15
        range -1 48

    config CYD_DISPLAY_PIN_RST
        int "CYD TFT RST GPIO"
        default -1
        range -1 48
        help
            Standard ESP32-2432S028R boards usually do not expose a dedicated
            display reset line.

    config CYD_DISPLAY_OFFSET_X
        int "CYD TFT X offset"
        default 0
        range -320 320

    config CYD_DISPLAY_OFFSET_Y
        int "CYD TFT Y offset"
        default 0
        range -320 320

    config CYD_DISPLAY_OFFSET_ROTATION
        int "CYD TFT rotation offset"
        default 0
        range 0 7

    config CYD_DISPLAY_RGB_ORDER
        bool "CYD TFT uses BGR/RGB swapped color order"
        default n
        help
            Enable this if red/blue colors appear swapped on your panel.

    config CYD_DISPLAY_INVERT
        bool "CYD TFT requires color inversion"
        default n
        help
            Enable this if black/white or general panel colors look inverted.

    config CYD_DISPLAY_READABLE
        bool "CYD TFT supports SPI readback"
        default y
        help
            Disable this on clone boards if display init works but the image is
            unstable or corrupted.

endmenu
```

## components/platform/sd_card_storage/Kconfig
```kconfig
menu "SD Card Storage"

    config SD_CARD_STORAGE_ENABLED
        bool "Enable SD card storage over SPI"
        default y
        help
            Mount a FAT-formatted SD card through the ESP-IDF SDSPI host.

    config SD_CARD_STORAGE_SPI_HOST
        int "SD card SPI host"
        default 3
        range 2 3
        depends on SD_CARD_STORAGE_ENABLED
        help
            2 = SPI2_HOST, 3 = SPI3_HOST.

    config SD_CARD_STORAGE_PIN_SCLK
        int "SD card SCLK GPIO"
        default 18
        range -1 48
        depends on SD_CARD_STORAGE_ENABLED

    config SD_CARD_STORAGE_PIN_MOSI
        int "SD card MOSI GPIO"
        default 23
        range -1 48
        depends on SD_CARD_STORAGE_ENABLED

    config SD_CARD_STORAGE_PIN_MISO
        int "SD card MISO GPIO"
        default 19
        range -1 48
        depends on SD_CARD_STORAGE_ENABLED

    config SD_CARD_STORAGE_PIN_CS
        int "SD card CS GPIO"
        default 5
        range -1 48
        depends on SD_CARD_STORAGE_ENABLED

    config SD_CARD_STORAGE_MOUNT_MAX_FILES
        int "SD card max open files"
        default 5
        range 1 32
        depends on SD_CARD_STORAGE_ENABLED

    config SD_CARD_STORAGE_ALLOCATION_UNIT_SIZE
        int "SD card allocation unit size"
        default 16384
        range 512 65536
        depends on SD_CARD_STORAGE_ENABLED
        help
            English supplement: FAT mount allocation unit hint passed to
            `esp_vfs_fat_sdspi_mount()`.

endmenu
```

## components/platform/xpt2046_softspi/Kconfig
```kconfig
menu "XPT2046 SoftSPI"

    config CYD_TOUCH_ENABLED
        bool "Enable CYD XPT2046 touch controller"
        default y

    config CYD_TOUCH_PIN_SCLK
        int "CYD touch SCLK GPIO"
        default 25
        range -1 48
        depends on CYD_TOUCH_ENABLED

    config CYD_TOUCH_PIN_MOSI
        int "CYD touch MOSI GPIO"
        default 32
        range -1 48
        depends on CYD_TOUCH_ENABLED

    config CYD_TOUCH_PIN_MISO
        int "CYD touch MISO GPIO"
        default 39
        range -1 48
        depends on CYD_TOUCH_ENABLED

    config CYD_TOUCH_PIN_CS
        int "CYD touch CS GPIO"
        default 33
        range -1 48
        depends on CYD_TOUCH_ENABLED

    config CYD_TOUCH_PIN_INT
        int "CYD touch interrupt GPIO"
        default 36
        range -1 48
        depends on CYD_TOUCH_ENABLED

    config CYD_TOUCH_OFFSET_ROTATION
        int "CYD touch rotation offset"
        default 0
        range 0 7
        depends on CYD_TOUCH_ENABLED
        help
            Additional touch rotation/flip adjustment before calibration.

    config CYD_TOUCH_X_MIN
        int "CYD touch raw X min"
        default 300
        range 0 4095
        depends on CYD_TOUCH_ENABLED

    config CYD_TOUCH_X_MAX
        int "CYD touch raw X max"
        default 3900
        range 0 4095
        depends on CYD_TOUCH_ENABLED

    config CYD_TOUCH_Y_MIN
        int "CYD touch raw Y min"
        default 400
        range 0 4095
        depends on CYD_TOUCH_ENABLED

    config CYD_TOUCH_Y_MAX
        int "CYD touch raw Y max"
        default 3900
        range 0 4095
        depends on CYD_TOUCH_ENABLED

endmenu
```

## components/services/esp32_wifi_sta/Kconfig
```kconfig
menu "ESP32 Wi-Fi STA"

    config ESP32_WIFI_STA_ENABLED
        bool "Enable ESP32 Wi-Fi station support"
        default n
        help
            Enables the project Wi-Fi STA component and optional app startup hook.

    config ESP32_WIFI_STA_AUTO_START
        bool "Start Wi-Fi manager during app startup"
        default n
        depends on ESP32_WIFI_STA_ENABLED
        help
            When enabled, app_main starts wifi_connection and time_sync after the
            display/input initialization. The Wi-Fi STA/radio normally remains
            off until a component such as time_sync acquires Wi-Fi.

    config ESP32_WIFI_STA_WAIT_ON_BOOT
        bool "Legacy: wait for Wi-Fi connection during app startup"
        default n
        depends on ESP32_WIFI_STA_AUTO_START
        help
            Legacy option retained for compatibility. The current app_main path
            starts wifi_connection/time_sync and does not block boot on Wi-Fi.

    config ESP32_WIFI_STA_SCAN_LIST_SIZE
        int "Wi-Fi scan record count"
        default 30
        range 1 64
        depends on ESP32_WIFI_STA_ENABLED
        help
            Maximum number of AP records kept in RAM while Wi-Fi scan mode is active.

    config ESP32_WIFI_STA_SSID
        string "Wi-Fi SSID"
        default ""
        depends on ESP32_WIFI_STA_ENABLED
        help
            SSID used by the default Wi-Fi STA configuration.

    config ESP32_WIFI_STA_PASSWORD
        string "Wi-Fi password"
        default ""
        depends on ESP32_WIFI_STA_ENABLED
        help
            Password used by the default Wi-Fi STA configuration. Leave empty
            only for open networks.

    config ESP32_WIFI_STA_MAX_RETRY
        int "Wi-Fi connect retry count"
        default 5
        range 0 100
        depends on ESP32_WIFI_STA_ENABLED

    config ESP32_WIFI_STA_RETRY_DELAY_MS
        int "Wi-Fi fresh retry delay (ms)"
        default 1000
        range 0 10000
        depends on ESP32_WIFI_STA_ENABLED
        help
            接続失敗後に STA を停止し、設定を再適用して再開するまでの待ち時間です。
            English: delay between fresh stop/reconfigure/start connection attempts.

    config ESP32_WIFI_STA_CONNECT_TIMEOUT_MS
        int "Wi-Fi boot wait timeout (ms)"
        default 15000
        range 100 120000
        depends on ESP32_WIFI_STA_ENABLED

    choice ESP32_WIFI_STA_SAE_MODE
        prompt "WPA3 SAE mode selection"
        default ESP32_WIFI_STA_WPA3_SAE_PWE_BOTH
        depends on ESP32_WIFI_STA_ENABLED
        help
            Select the SAE PWE derivation mode for WPA3-Personal networks.

        config ESP32_WIFI_STA_WPA3_SAE_PWE_HUNT_AND_PECK
            bool "HUNT AND PECK"

        config ESP32_WIFI_STA_WPA3_SAE_PWE_HASH_TO_ELEMENT
            bool "H2E"

        config ESP32_WIFI_STA_WPA3_SAE_PWE_BOTH
            bool "BOTH"
    endchoice

    config ESP32_WIFI_STA_SAE_H2E_IDENTIFIER
        string "WPA3 SAE H2E password identifier"
        default ""
        depends on ESP32_WIFI_STA_ENABLED && (ESP32_WIFI_STA_WPA3_SAE_PWE_HASH_TO_ELEMENT || ESP32_WIFI_STA_WPA3_SAE_PWE_BOTH)
        help
            Optional password identifier used with SAE Hash-to-Element.

    choice ESP32_WIFI_STA_SCAN_AUTH_MODE_THRESHOLD
        prompt "Wi-Fi scan auth mode threshold"
        default ESP32_WIFI_STA_AUTH_WPA2_PSK
        depends on ESP32_WIFI_STA_ENABLED
        help
            The weakest auth mode accepted during scan/connect.
            Select WEP/WPA only when connecting to deprecated networks.

        config ESP32_WIFI_STA_AUTH_OPEN
            bool "OPEN"

        config ESP32_WIFI_STA_AUTH_WEP
            bool "WEP"

        config ESP32_WIFI_STA_AUTH_WPA_PSK
            bool "WPA PSK"

        config ESP32_WIFI_STA_AUTH_WPA2_PSK
            bool "WPA2 PSK"

        config ESP32_WIFI_STA_AUTH_WPA_WPA2_PSK
            bool "WPA/WPA2 PSK"

        config ESP32_WIFI_STA_AUTH_WPA3_PSK
            bool "WPA3 PSK"

        config ESP32_WIFI_STA_AUTH_WPA2_WPA3_PSK
            bool "WPA2/WPA3 PSK"

        config ESP32_WIFI_STA_AUTH_WAPI_PSK
            bool "WAPI PSK"
    endchoice

endmenu
```

## components/services/radio_manager/Kconfig
```kconfig
menu "Radio Manager"

    config RADIO_MANAGER_TASK_STACK_SIZE
        int "Radio manager task stack size"
        default 4096

    config RADIO_MANAGER_TASK_PRIORITY
        int "Radio manager task priority"
        default 7

    config RADIO_MANAGER_REQUEST_QUEUE_LEN
        int "Radio lease request queue length"
        default 5

    config RADIO_MANAGER_CONTROL_QUEUE_LEN
        int "Radio lease control queue length"
        default 5

    config RADIO_MANAGER_IDLE_TIMEOUT_MS
        int "Radio idle timeout (ms)"
        default 30000
        help
            Time to keep the radio/Wi-Fi lease alive after the last client
            releases it. Default is 30 seconds for development visibility.

endmenu
```

## components/services/wifi_connection/Kconfig
```kconfig
menu "Wi-Fi Connection"

    config WIFI_CONNECTION_TASK_STACK_SIZE
        int "Wi-Fi connection task stack size"
        default 8192
        range 7168 32768
        depends on ESP32_WIFI_STA_ENABLED
        help
            Wi-Fi connection task の stack size です。
            English: this task manages STA state and connection requests,
            while the foreground setup UI runs on the app_shell task.

    config WIFI_CONNECTION_TASK_PRIORITY
        int "Wi-Fi connection task priority"
        default 8
        range 1 24
        depends on ESP32_WIFI_STA_ENABLED

    config WIFI_CONNECTION_MONITOR_INTERVAL_MS
        int "Wi-Fi connection monitor interval (ms)"
        default 2000
        range 500 60000
        depends on ESP32_WIFI_STA_ENABLED
        help
            Interval used while connected to poll the STA status and detect
            reconnection/setup transitions.

    config WIFI_CONNECTION_STACK_LOG_INTERVAL_MS
        int "Wi-Fi connection stack log interval (ms)"
        default 30000
        range 1000 600000
        depends on ESP32_WIFI_STA_ENABLED
        help
            Minimum interval between Wi-Fi connection stack high-water log lines.

    config WIFI_CONNECTION_SCAN_RETRY_ATTEMPTS
        int "Wi-Fi scan retry attempts for saved SSIDs"
        default 5
        range 1 20
        depends on ESP32_WIFI_STA_ENABLED
        help
            保存済み SSID が見つからない場合に再スキャンする最大回数です。
            English supplement: Used only when saved SSIDs are not visible in scan results.

    config WIFI_CONNECTION_SCAN_RETRY_DELAY_MS
        int "Wi-Fi scan retry delay (ms)"
        default 3000
        range 0 60000
        depends on ESP32_WIFI_STA_ENABLED
        help
            再スキャンまでの待ち時間です。
            English supplement: This delay is inserted between scan attempts for transient radio conditions.

endmenu
```
