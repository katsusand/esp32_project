## components/app_shell/Kconfig
```kconfig
menu "App Shell"

    config APP_SHELL_TASK_STACK_SIZE
        int "App shell task stack size"
        default 6144
        range 3072 16384
        help
            `app_shell` task の stack size です。
            English: this single owner task runs the active foreground app and
            owns `cyd_display`, so its stack must cover the active app step.

    config APP_SHELL_TASK_PRIORITY
        int "App shell task priority"
        default 5
        range 1 24
        help
            `app_shell` task priority です。

endmenu
```

## components/apps/cyd_clock_app/Kconfig
```kconfig
menu "CYD Clock App"
    config CYD_CLOCK_APP_UPDATE_INTERVAL_MS
        int "CYD clock app update interval (ms)"
        default 1000
        range 250 60000
        help
            時計画面を更新する間隔です。

    config CYD_CLOCK_APP_STACK_LOG_INTERVAL_MS
        int "CYD clock app stack log interval (ms)"
        default 30000
        range 1000 600000
        help
            Minimum interval between clock app stack high-water log lines.

endmenu
```

## components/cyd_input/Kconfig
```kconfig
menu "CYD Input"

    config CYD_TOUCH_ENABLED
        bool "Enable CYD XPT2046 touch controller"
        default y

    config CYD_TOUCH_SPI_HOST
        int "CYD touch SPI host"
        default 3
        range 2 3
        depends on CYD_TOUCH_ENABLED
        help
            2 = SPI2_HOST, 3 = SPI3_HOST.

    config CYD_TOUCH_PIN_SCLK
        int "CYD touch SCLK GPIO"
        default 25
        range -1 48
        depends on CYD_TOUCH_ENABLED

    config CYD_TOUCH_PIN_MOSI
        int "CYD touch MOSI GPIO"
        default 32
        range -1 48
        depends on CYD_TOUCH_ENABLED

    config CYD_TOUCH_PIN_MISO
        int "CYD touch MISO GPIO"
        default 39
        range -1 48
        depends on CYD_TOUCH_ENABLED

    config CYD_TOUCH_PIN_CS
        int "CYD touch CS GPIO"
        default 33
        range -1 48
        depends on CYD_TOUCH_ENABLED

    config CYD_TOUCH_PIN_INT
        int "CYD touch interrupt GPIO"
        default 36
        range -1 48
        depends on CYD_TOUCH_ENABLED

    config CYD_TOUCH_OFFSET_ROTATION
        int "CYD touch rotation offset"
        default 0
        range 0 7
        depends on CYD_TOUCH_ENABLED
        help
            Additional touch rotation/flip adjustment before calibration.

    config CYD_TOUCH_X_MIN
        int "CYD touch raw X min"
        default 300
        range 0 4095
        depends on CYD_TOUCH_ENABLED

    config CYD_TOUCH_X_MAX
        int "CYD touch raw X max"
        default 3900
        range 0 4095
        depends on CYD_TOUCH_ENABLED

    config CYD_TOUCH_Y_MIN
        int "CYD touch raw Y min"
        default 400
        range 0 4095
        depends on CYD_TOUCH_ENABLED

    config CYD_TOUCH_Y_MAX
        int "CYD touch raw Y max"
        default 3900
        range 0 4095
        depends on CYD_TOUCH_ENABLED

    config CYD_TOUCH_POLL_PERIOD_MS
        int "CYD touch polling period (ms)"
        default 10
        range 1 1000
        depends on CYD_TOUCH_ENABLED
        help
            Polling period for touch sampling. 10 ms matches a 100 Hz RTOS tick.

    config CYD_TOUCH_USE_IRQ
        bool "Wake CYD touch polling from IRQ"
        default y
        depends on CYD_TOUCH_ENABLED
        help
            Use the XPT2046 T_IRQ line to wake the touch task when a touch
            starts. The task still polls while pressed so release, movement,
            long-press, and click timing remain deterministic.

    config CYD_TOUCH_IDLE_POLL_PERIOD_MS
        int "CYD touch idle fallback polling period (ms)"
        default 250
        range 50 5000
        depends on CYD_TOUCH_ENABLED
        help
            Fallback interval used while the touch task is waiting for T_IRQ.
            This catches missed edges or boards where the IRQ line is already
            low before the task arms the interrupt.

    config CYD_INPUT_BINARY_STABLE_COUNT
        int "CYD input binary stable sample count"
        default 2
        range 1 8
        help
            Number of consecutive identical binary samples required before a
            touch or switch state change is accepted.

    config CYD_BOOT_BUTTON_ENABLED
        bool "Enable BOOT button GPIO input events"
        default y
        help
            GPIO0 BOOT ボタンを通常動作中の入力として扱います。
            English supplement: GPIO0 is a boot strapping pin. Pressing it
            during reset enters UART download mode, but after the application
            has booted it can be sampled as an active-low GPIO button.

    config CYD_BOOT_BUTTON_GPIO
        int "CYD BOOT button GPIO"
        default 0
        range 0 48
        depends on CYD_BOOT_BUTTON_ENABLED
        help
            BOOT ボタンに接続された GPIO 番号です。一般的な ESP32 DevKit /
            CYD では GPIO0 です。

    config CYD_BOOT_BUTTON_ENABLE_INTERNAL_PULLUP
        bool "Enable internal pull-up for BOOT button"
        default y
        depends on CYD_BOOT_BUTTON_ENABLED
        help
            BOOT ボタンは通常 active-low なので、内部 pull-up を有効にします。
            English supplement: Disable this only when the board already
            provides the required external pull-up or the pin is shared in a
            way that must not alter pull configuration.

    config CYD_BOOT_BUTTON_LONG_PRESS_MAX_SECONDS
        int "CYD BOOT button long press max seconds"
        default 15
        range 1 15
        depends on CYD_BOOT_BUTTON_ENABLED
        help
            BOOT ボタン長押しイベントで通知する最大秒数です。
            English supplement: Long-press events are emitted once per second
            while held, capped at this value.

    config CYD_BOOT_BUTTON_DOUBLE_CLICK_TIMEOUT_MS
        int "CYD BOOT button double click timeout (ms)"
        default 500
        range 50 2000
        depends on CYD_BOOT_BUTTON_ENABLED
        help
            BOOT ボタンの短押しを double click としてまとめる最大間隔です。
            English supplement: A single click is delayed until this timeout
            expires. A second short press/release within the timeout emits
            DOUBLE_CLICK immediately instead.

    config CYD_TOUCH_LOG_EVENTS
        bool "Log CYD touch events to serial"
        default y
        depends on CYD_TOUCH_ENABLED
        help
            When enabled, debounced touch press/release and coordinate updates
            are logged.

    config CYD_TOUCH_LOG_IRQ_LEVEL
        bool "Include CYD touch IRQ level in serial logs"
        default y
        depends on CYD_TOUCH_LOG_EVENTS
        help
            Useful for checking whether the interrupt line reacts while touching.

    config CYD_TOUCH_USE_NVS_CALIBRATION
        bool "Load/save CYD touch calibration in NVS"
        default y
        depends on CYD_TOUCH_ENABLED

    config CYD_TOUCH_RUN_CALIBRATION_ON_BOOT
        bool "Run touch calibration on boot if none is saved"
        default n
        depends on CYD_TOUCH_USE_NVS_CALIBRATION

    config CYD_INPUT_EVENT_QUEUE_LENGTH
        int "CYD input event queue length"
        default 16
        range 1 32
        help
            入力イベントを保持する FreeRTOS queue の長さです。
            English supplement: When full, the oldest event is dropped so recent touch intent is preserved.

    config CYD_INPUT_LONG_PRESS_MS
        int "CYD input long press threshold (ms)"
        default 500
        range 10 5000
        help
            Hold duration required before a long-press event is emitted.

    config CYD_INPUT_LONG_PRESS_REPEAT_MS
        int "CYD input long press repeat interval (ms)"
        default 1000
        range 100 5000
        help
            Interval for repeated long-press progress events after the initial
            long-press threshold has been reached.

    config CYD_INPUT_TOUCH_REPEAT_MS
        int "CYD input repeat interval (ms)"
        default 250
        range 100 5000
        help
            Interval for repeat events after the initial long-press threshold
            has been reached. Repeat events do not carry hold_ticks.

endmenu
```

## components/cyd_speaker/Kconfig
```kconfig
menu "CYD Speaker"

    config CYD_SPEAKER_ENABLED
        bool "Enable CYD speaker output"
        default y

    config CYD_SPEAKER_GPIO
        int "CYD speaker GPIO"
        default 26
        range -1 48
        depends on CYD_SPEAKER_ENABLED
        help
            PWM output GPIO for the CYD speaker or passive buzzer.

    config CYD_SPEAKER_LEDC_TIMER
        int "CYD speaker LEDC timer"
        default 0
        range 0 3
        depends on CYD_SPEAKER_ENABLED

    config CYD_SPEAKER_LEDC_CHANNEL
        int "CYD speaker LEDC channel"
        default 0
        range 0 7
        depends on CYD_SPEAKER_ENABLED

    config CYD_SPEAKER_VOLUME_PERCENT
        int "CYD speaker volume percent"
        default 50
        range 1 100
        depends on CYD_SPEAKER_ENABLED
        help
            Approximate PWM duty scale. Passive buzzers are usually loudest near 50 percent duty.

endmenu
```

## components/cyd_status_led/Kconfig
```kconfig
menu "CYD Status LED"

    config CYD_STATUS_LED_RED_GPIO
        int "CYD RGB LED red GPIO"
        default 4
        range 0 48
        help
            GPIO used by the CYD onboard red LED channel.

    config CYD_STATUS_LED_GREEN_GPIO
        int "CYD RGB LED green GPIO"
        default 16
        range 0 48
        help
            GPIO used by the CYD onboard green LED channel.

    config CYD_STATUS_LED_BLUE_GPIO
        int "CYD RGB LED blue GPIO"
        default 17
        range 0 48
        help
            GPIO used by the CYD onboard blue LED channel.

endmenu
```

## components/esp32_wifi_sta/Kconfig
```kconfig
menu "ESP32 Wi-Fi STA"

    config ESP32_WIFI_STA_ENABLED
        bool "Enable ESP32 Wi-Fi station support"
        default n
        help
            Enables the project Wi-Fi STA component and optional app startup hook.

    config ESP32_WIFI_STA_AUTO_START
        bool "Start Wi-Fi STA during app startup"
        default n
        depends on ESP32_WIFI_STA_ENABLED
        help
            When enabled, app_main initializes and starts Wi-Fi STA after NVS
            initialization. Credentials are read from this Kconfig menu.

    config ESP32_WIFI_STA_WAIT_ON_BOOT
        bool "Wait for Wi-Fi connection during app startup"
        default n
        depends on ESP32_WIFI_STA_AUTO_START
        help
            If enabled, app_main waits for the configured timeout after starting
            Wi-Fi. A timeout is logged but does not stop the application.

    config ESP32_WIFI_STA_SCAN_LIST_SIZE
        int "Wi-Fi scan record count"
        default 30
        range 1 64
        depends on ESP32_WIFI_STA_ENABLED
        help
            Maximum number of AP records kept in RAM while Wi-Fi scan mode is active.

    config ESP32_WIFI_STA_SSID
        string "Wi-Fi SSID"
        default ""
        depends on ESP32_WIFI_STA_ENABLED
        help
            SSID used by the default Wi-Fi STA configuration.

    config ESP32_WIFI_STA_PASSWORD
        string "Wi-Fi password"
        default ""
        depends on ESP32_WIFI_STA_ENABLED
        help
            Password used by the default Wi-Fi STA configuration. Leave empty
            only for open networks.

    config ESP32_WIFI_STA_MAX_RETRY
        int "Wi-Fi connect retry count"
        default 5
        range 0 100
        depends on ESP32_WIFI_STA_ENABLED

    config ESP32_WIFI_STA_CONNECT_TIMEOUT_MS
        int "Wi-Fi boot wait timeout (ms)"
        default 15000
        range 100 120000
        depends on ESP32_WIFI_STA_ENABLED

    choice ESP32_WIFI_STA_SAE_MODE
        prompt "WPA3 SAE mode selection"
        default ESP32_WIFI_STA_WPA3_SAE_PWE_BOTH
        depends on ESP32_WIFI_STA_ENABLED
        help
            Select the SAE PWE derivation mode for WPA3-Personal networks.

        config ESP32_WIFI_STA_WPA3_SAE_PWE_HUNT_AND_PECK
            bool "HUNT AND PECK"

        config ESP32_WIFI_STA_WPA3_SAE_PWE_HASH_TO_ELEMENT
            bool "H2E"

        config ESP32_WIFI_STA_WPA3_SAE_PWE_BOTH
            bool "BOTH"
    endchoice

    config ESP32_WIFI_STA_SAE_H2E_IDENTIFIER
        string "WPA3 SAE H2E password identifier"
        default ""
        depends on ESP32_WIFI_STA_ENABLED && (ESP32_WIFI_STA_WPA3_SAE_PWE_HASH_TO_ELEMENT || ESP32_WIFI_STA_WPA3_SAE_PWE_BOTH)
        help
            Optional password identifier used with SAE Hash-to-Element.

    choice ESP32_WIFI_STA_SCAN_AUTH_MODE_THRESHOLD
        prompt "Wi-Fi scan auth mode threshold"
        default ESP32_WIFI_STA_AUTH_WPA2_PSK
        depends on ESP32_WIFI_STA_ENABLED
        help
            The weakest auth mode accepted during scan/connect.
            Select WEP/WPA only when connecting to deprecated networks.

        config ESP32_WIFI_STA_AUTH_OPEN
            bool "OPEN"

        config ESP32_WIFI_STA_AUTH_WEP
            bool "WEP"

        config ESP32_WIFI_STA_AUTH_WPA_PSK
            bool "WPA PSK"

        config ESP32_WIFI_STA_AUTH_WPA2_PSK
            bool "WPA2 PSK"

        config ESP32_WIFI_STA_AUTH_WPA_WPA2_PSK
            bool "WPA/WPA2 PSK"

        config ESP32_WIFI_STA_AUTH_WPA3_PSK
            bool "WPA3 PSK"

        config ESP32_WIFI_STA_AUTH_WPA2_WPA3_PSK
            bool "WPA2/WPA3 PSK"

        config ESP32_WIFI_STA_AUTH_WAPI_PSK
            bool "WAPI PSK"
    endchoice

endmenu
```
